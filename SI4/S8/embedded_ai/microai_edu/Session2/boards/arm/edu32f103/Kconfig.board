## SI4/S8/embedded_ai/microai_edu/Session2/boards/arm/edu32f103/Kconfig.board
```kconfig
# 32F103 EDU board configuration

# Copyright (c) 2022 piernov
# SPDX-License-Identifier: Apache-2.0

config BOARD_EDU32F103
	bool "32F103 EDU Board"
	depends on SOC_STM32F103XB
```

## SI4/S8/embedded_ai/microai_edu/Session2/boards/arm/edu32f103/Kconfig.defconfig
```kconfig
# 32F103 EDU board configuration

# Copyright (c) 2022 piernov
# SPDX-License-Identifier: Apache-2.0

if BOARD_EDU32F103

config BOARD
	default "edu32f103"

endif # BOARD_EDU32F103
```

## SI4/S8/embedded_ai/microai_edu/Session2/boards/arm/edu32f103/edu32f103_defconfig
```kconfig
# SPDX-License-Identifier: Apache-2.0

CONFIG_SOC_SERIES_STM32F1X=y
CONFIG_SOC_STM32F103XE=y

# enable uart driver
CONFIG_SERIAL=y
# enable console
CONFIG_CONSOLE=y
CONFIG_UART_CONSOLE=y

# enable GPIO
CONFIG_GPIO=y

# enable clock
CONFIG_CLOCK_CONTROL=y

# enable pin controller
CONFIG_PINCTRL=y

# enable ADC
CONFIG_ADC=y

# enable SPI for accelerometer
CONFIG_SPI=y

# enable sensors driver
CONFIG_SENSOR=y

# USB
CONFIG_USB_DEVICE_STACK=y
CONFIG_USB_COMPOSITE_DEVICE=y
```

## SI4/S8/embedded_ai/microai_edu/Session2/manifest/west.yml
```yaml
manifest:
  remotes:
    - name: zephyrproject-rtos
      url-base: https://github.com/zephyrproject-rtos
  projects:
    - name: zephyr
      remote: zephyrproject-rtos
      revision: v3.5.0
      import:
        name-allowlist:
          - hal_stm32
          - cmsis
```
